## src/Battery/Kconfig
```kconfig
menu "Battery Configuration"

config BATTERY_SYSDOWN_SET_OFFSET
	int "System Down Set Voltage Offset (mV)"
	default 250
	help
	  Offset added to VLO voltage for System Down Set threshold

config BATTERY_SYSDOWN_HYSTERESIS
	int "System Down Clear Voltage Offset (mV)"
	default 100
	help
	  Offset added to VLO voltage for System Down Clear threshold

config BATTERY_FD_SET_OFFSET
	int "Full Discharge Set Voltage Offset (mV)"
	default 100
	help
	  Offset added to VLO voltage for Full Discharge Set threshold

config BATTERY_FD_HYSTERESIS
	int "Full Discharge Clear Voltage Offset (mV)"
	default 100
	help
	  Offset added to VLO voltage for Full Discharge Clear threshold

config BATTERY_FC_VOLTAGE_OFFSET
	int "Full Charge Voltage Offset (mV)"
	default 10
	help
	  Offset subtracted from terminal voltage for Full Charge threshold

config BATTERY_CHARGE_CONTROLLER_INTERVAL_SECONDS
	int "Charge Controller Check Interval (seconds)"
	default 10
	help
	  Time interval between charge controller status checks

config BATTERY_CHARGE_CONTROLLER_NORMAL_INTERVAL_SECONDS
	int "Normal Charge Controller Check Interval (seconds)"
	default 10
	help
	  Time interval between charge controller status checks in normal operation

config BATTERY_CHARGE_CONTROLLER_FAST_INTERVAL_SECONDS
	int "Fast Charge Controller Check Interval (seconds)"
	default 1
	help
	  Time interval between charge controller status checks when in FAULT or POWER_CONNECTED state

config BATTERY_ENABLE_LOW_STATE
	bool "Enable Battery Low State"
	default n
	help
	  If enabled, battery state will change to BATTERY_LOW when EDV2 is reached

config BATTERY_ENABLE_TRICKLE_CHARGE
	bool "Enable Trickle Charge State"
	default y
	help
	  If enabled, battery state will change to TRICKLE_CHARGING when voltage is close to terminal voltage

config SETUP_FUEL_GAUGE
	bool "Setup Fuel Gauge on Boot"
	default n
	help
	  If enabled, fuel gauge will be setup during boot process

config OPENEARABLE_ADAU_I2C_TEST_FORCE_POWER_ON
	bool "Force power-on for ADAU1860 I2C diagnostics"
	default n
	help
	  Diagnostic option for board bring-up. Keeps the normal battery and
	  fuel-gauge setup path, but forces the firmware past the charger
	  wait-for-wake condition so the ADAU1860 audio initialization can run.

config OPENEARABLE_ADAU_I2C_TEST_SKIP_FUEL_GAUGE_SETUP
	bool "Skip BQ27220 setup for ADAU1860 I2C diagnostics"
	default n
	help
	  Diagnostic option for board bring-up. Avoids blocking forever in the
	  BQ27220 CONFIG UPDATE loop when the fuel-gauge I2C path is not reliable,
	  so the firmware can continue far enough to test ADAU1860 I2C access.

config OPENEARABLE_BQ27220_FORCE_SETUP_ON_BOOT
	bool "Force BQ27220 setup on boot for diagnostics"
	default n
	help
	  Diagnostic option for validating BQ27220 data-memory writes. When
	  enabled, the firmware runs the fuel-gauge setup path once during boot
	  even if the reported DesignCapacity already matches the board settings.

config OPENEARABLE_I2C3_SCAN_TEST
	bool "Run I2C3 scan diagnostics at boot"
	default n
	help
	  Diagnostic option for board bring-up. When enabled, the application keeps
	  the 1.8 V load switch on and scans the I2C3 sensor bus at several bus
	  speeds, logging ACK addresses and register 0 values over RTT.

endmenu
```
